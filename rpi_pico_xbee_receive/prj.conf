## CMakeLists.txt
```
cmake_minimum_required(VERSION 3.20.0)
set(CMAKE_CXX_STANDARD 17)
#SET(CMAKE_CXX_FLAGS "${CMAKE_CXX_FLAGS} -std=c++14") 
set(BOARD rpi_pico)

#drivers
include_directories(include)
# list(APPEND ZEPHYR_EXTRA_MODULES ${CMAKE_CURRENT_SOURCE_DIR}/drivers)

find_package(Zephyr REQUIRED HINTS $ENV{ZEPHYR_BASE})
project(payload)

#target_sources(app PRIVATE src/main.cpp)
include_directories(src)
file(GLOB_RECURSE SRCS src/**.cpp)
target_sources(app PRIVATE ${SRCS})
```

## prj.conf
```kconfig
CONFIG_CPLUSPLUS=y
CONFIG_NEWLIB_LIBC=y
CONFIG_LIB_CPLUSPLUS=y
CONFIG_NEWLIB_LIBC_FLOAT_PRINTF=y
CONFIG_SERIAL=y
CONFIG_XBEE=y
CONFIG_GPIO=y
CONFIG_SENSOR=y
CONFIG_I2C=y
CONFIG_BME280=y

CONFIG_SMF=y

CONFIG_LOG=y

CONFIG_SERIAL=y
CONFIG_PINCTRL=y
CONFIG_MAIN_STACK_SIZE=4096
CONFIG_CBPRINTF_FP_SUPPORT=y
```

## src/main.cpp
```c
/*
 * Copyright (c) 2023 Libre Solar Technologies GmbH
 *
 * SPDX-License-Identifier: Apache-2.0
 */

#include <stdio.h>
#include <zephyr/kernel.h>
#include <zephyr/devicetree.h>
#include <zephyr/device.h>
#include <zephyr/drivers/sensor.h>
#include <zephyr/drivers/gpio.h>
#include "drivers/xbee/xbee.hpp"


#define XBEE_UART_NODE DT_CHOSEN(cansat_xbee)


int main(void)
{
	const struct device *xbee_node_dev = DEVICE_DT_GET(XBEE_UART_NODE);
	drivers::xbee::Xbee xbee(xbee_node_dev);

    //TX----------------------------------------------------------
    drivers::xbee::detail::request::transmit_request tx_req;
    tx_req.set_dst_address(0x0013A20041CFED46);
    tx_req.set_frame_id(0);

    //RX------------------------------------------------------------
    xbee.set_rx_callback([this](std::unique_ptr<drivers::xbee::i_response> response)
        { handleCommand(response->get_string()); });

	//LED
	static const struct gpio_dt_spec led_dev = GPIO_DT_SPEC_GET(DT_NODELABEL(led), gpios);
    gpio_pin_configure_dt(&led_dev, GPIO_OUTPUT_ACTIVE);
	
    while(1){
		//LED-------------------------------------------------------------
        gpio_pin_toggle_dt(&led_dev);

        //XBEE-------------------------------------------------------------
        // tx_req.set_payload("temp: "+std::to_string(temp.val1)+"."+std::to_string(temp.val2)+
        //                    " ,press: "+std::to_string(press.val1)+"."+std::to_string(press.val2)+
        //                    " ,humidity: "+std::to_string(humidity.val1)+"."+std::to_string(humidity.val2));
		
        //TX---------------------------------------------------
        tx_req.set_payload("1066,13:14:02.22,1000,F,LAUNCH_WAIT,800.1,100.1,N,N,37.1,%s,121.1,13:14:02.22,700.1,-37.4003,-37.4003\n");
        tx_req.calculate_length();
        tx_req.calculate_checksum();
        xbee.send_request(tx_req);
        
		k_sleep(K_MSEC(1000));
    }
	return 0;
}
```
