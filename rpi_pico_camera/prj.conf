## CMakeLists.txt
```
cmake_minimum_required(VERSION 3.20.0)

set(BOARD rpi_pico)
#set(DTC_OVERLAY_FILE ${CMAKE_CURRENT_SOURCE_DIR}/rpi_pico.overlay)

include_directories(include)
# list(APPEND ZEPHYR_EXTRA_MODULES ${CMAKE_CURRENT_SOURCE_DIR}/drivers)

find_package(Zephyr REQUIRED HINTS $ENV{ZEPHYR_BASE})
project(payload)

# target_sources(app PRIVATE src/main.cpp)

include_directories(src)
file(GLOB_RECURSE SRCS src/**.cpp)
target_sources(app PRIVATE ${SRCS})
```

## prj.conf
```kconfig
CONFIG_CPLUSPLUS=y
CONFIG_NEWLIB_LIBC=y
CONFIG_LIB_CPLUSPLUS=y
CONFIG_NEWLIB_LIBC_FLOAT_PRINTF=y
CONFIG_GPIO=y
```

## rpi_pico.overlay
```dts
/ {
	camera: camera {
        compatible = "gpio-ctrl";
        gpios = <&gpio0 15 0x0>;
    };
};
```

## src/main.cpp
```c
/*
 * Copyright (c) 2023 Libre Solar Technologies GmbH
 *
 * SPDX-License-Identifier: Apache-2.0
 */

#include <stdio.h>
#include <zephyr/kernel.h>
#include <zephyr/devicetree.h>
#include <zephyr/device.h>
#include <zephyr/drivers/gpio.h>

#include "subsys/camera/camera.hpp"

using namespace payload;

#define CAMERA_NODE	DT_NODELABEL(camera)

int main(void)
{
	//CAMERA
	static const gpio_dt_spec camera_dev = GPIO_DT_SPEC_GET(CAMERA_NODE, gpios);

	subsys::Camera camera(camera_dev);
	camera.startRecording();
    printk("Ciao mamma sono in tv\n");
	k_msleep(15000);
	printk("Fine trasmissione\n");
	camera.stopRecording();
	
    // while(1){
	// 	//LED-------------------------------------------------------------
    //     printk("nel main\n");
    //     k_msleep(500);
    // }
	return 0;
}
```
